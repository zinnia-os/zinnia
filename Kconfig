## Kconfig
```kconfig
mainmenu "Zinnia Kernel Configuration"

config KERNEL_FLAVOR
  string "Kernel flavor name"
  default "vanilla"

config MODULES
  bool "Loadable module support"
  default y
  option modules

source "kernel/arch/$(ARCH)/Kconfig"
source "kernel/boot/Kconfig"
source "kernel/mem/Kconfig"
source "kernel/lib/Kconfig"
source "kernel/dev/Kconfig"
source "tests/Kconfig"
```

## kernel/arch/riscv64/Kconfig
```kconfig
menu "RISC-V Architecture options"

config RISCV64
  bool
  default y
  select ACPI
  select HAVE_EFISTUB
  select HAVE_MMU
  select HAVE_MMU_GENERIC
  select HAVE_TLB_SHOOTDOWN_IPI
  help
    64-bit RISC-V CPU support.

endmenu
```

## kernel/arch/x86_64/Kconfig
```kconfig
menu "x86_64 Architecture options"

config X86_64
  bool
  default y
  select ACPI
  select HAVE_EFISTUB
  select HAVE_MMU
  select HAVE_MMU_GENERIC
  select HAVE_TLB_SHOOTDOWN_IPI
  help
    64-bit x86 CPU support for AMD and Intel CPUs.

config TSC
  bool "Invariant Timestamp Counter support"
  default y

endmenu
```

## kernel/boot/Kconfig
```kconfig
config HAVE_EFISTUB
  bool

menu "Boot loaders"

config BOOT_EFISTUB
  bool "EFI stub"
  depends on HAVE_EFISTUB
  default y
  help
    Kernel loader for UEFI systems.

config BOOT_LIMINE
  bool "Limine"
  default n
  help
    ELF loader with the Limine protocol.

endmenu
```

## kernel/dev/Kconfig
```kconfig
menu "Device Drivers"

config OF
  bool "Support for OpenFirmware"
  default y
  help
    Adds support for flattened device trees and OF platform drivers.

config ACPI
  bool "Support for ACPI firmware"
  default y
  help
    Adds support for ACPI firmware, tables and devices.

source "kernel/dev/block/Kconfig"
source "kernel/dev/pci/Kconfig"
source "kernel/dev/video/Kconfig"

endmenu
```

## kernel/dev/pci/Kconfig
```kconfig
menu "PCI bus drivers"

config PCI
  bool "PCI core drivers"
  default y

endmenu
```

## kernel/dev/serial/Kconfig
```kconfig
menu "Serial drivers"

config NS16550A
  bool "NS16550A UART serial controller"
  default y

endmenu
```

## kernel/dev/video/Kconfig
```kconfig
menu "Video Drivers"

config FBCON
  bool "Framebuffer console"
  default y
  help
    Adds a basic console that can draw on a framebuffer passed by firmware.

endmenu
```

## kernel/fs/Kconfig
```kconfig
menu "File systems"

config EXT2
  tristate "Second extended file system"
  default y

endmenu
```

## kernel/lib/Kconfig
```kconfig
menu "Scheduler options"

choice SCHED_ALG
  prompt "Scheduler algorithm"
  default SCHED_DUMB
  help
    The algorithm to use for scheduling.

config SCHED_DUMB
  bool "Dumb Scheduler"
  help
    Very basic scheduler.

endchoice

endmenu
```

## kernel/mem/Kconfig
```kconfig
menu "Memory Management options"

config HAVE_MMU
  bool
config HAVE_MMU_GENERIC
  bool
config HAVE_MMU_SPLIT_ROOT
  bool
config HAVE_TLB_SHOOTDOWN_IPI
  bool

endmenu
```

## tests/Kconfig
```kconfig
menu "Testing"

config KTEST
  bool "Kernel test suite"
  depends on BOOT_EFISTUB
  default n
  help
    Builds the kernel unit tests. To run them, add "ktest=1" to the cmdline.

endmenu
```
